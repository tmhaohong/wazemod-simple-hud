## waze-hud/main/Kconfig.projbuild
```kconfig
menu "Waze HUD firmware"

config WAZE_HUD_LCD_ILI9341
    bool "Use 2.8-inch ILI9341 SPI LCD instead of T-Display-S3"
    default n

if WAZE_HUD_LCD_ILI9341

config WAZE_HUD_LCD_SCLK
    int "LCD SCLK GPIO (-1 = unconfigured)"
    range -1 48
    default -1

config WAZE_HUD_LCD_MOSI
    int "LCD MOSI GPIO (-1 = unconfigured)"
    range -1 48
    default -1

config WAZE_HUD_LCD_CS
    int "LCD CS GPIO (-1 = unconfigured)"
    range -1 48
    default -1

config WAZE_HUD_LCD_DC
    int "LCD DC GPIO (-1 = unconfigured)"
    range -1 48
    default -1

config WAZE_HUD_LCD_RESET
    int "LCD RESET GPIO (-1 = externally wired reset)"
    range -1 48
    default -1

config WAZE_HUD_LCD_BACKLIGHT
    int "LCD backlight GPIO (-1 = externally powered)"
    range -1 48
    default -1

config WAZE_HUD_LCD_BACKLIGHT_ACTIVE_LOW
    bool "Backlight is active low"
    default n

config WAZE_HUD_LCD_BGR
    bool "LCD uses BGR color order"
    default y

config WAZE_HUD_LCD_INVERT
    bool "Invert LCD colors"
    default n

endif

config WAZE_HUD_TDISPLAY_PERIPHERALS
    bool "Enable T-Display-S3 GPIO14 button and GPIO4 battery divider"
    default y if !WAZE_HUD_LCD_ILI9341
    default n

config WAZE_HUD_MOCK_MODE
    bool "Enable renderer mock mode"
    default n
    help
      Cycle deterministic renderer scenarios without requiring a phone.
      Lane guidance exercises the real HLP/1 direction-mask representation.

config WAZE_HUD_DEFAULT_BRIGHTNESS
    int "Default backlight brightness (percent)"
    range 10 100
    default 70
    help
        Must align with the HLP configuration slider's 5 percent step.

config WAZE_HUD_HEADLESS_DIAGNOSTIC
    bool "Disable LCD/UI for watchdog isolation"
    default n
    help
        Keep BLE, HLP, state and configuration active while skipping display
        initialization and the UI task. Intended only for hardware diagnosis.

config WAZE_HUD_UI_TASK_CORE
    int "UI task core"
    range 0 1
    default 1

endmenu
```
